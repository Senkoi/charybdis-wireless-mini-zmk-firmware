## config/dts/bindings/input-processor/zmk,input-processor-distance-filter-layer.yaml
```yaml
description: Distance filter input processor for ZMK

compatible: "zmk,input-processor-distance-filter-layer"

include: base.yaml

properties:
  timeout-ms:
    type: int
    required: true
  min-move-threshold:
    type: int
    required: true

input-processor-cells:
  - name: none
```

## config/west.yml
```yaml
manifest:
  remotes:
    - name: zmkfirmware
      url-base: https://github.com/zmkfirmware

    - name: badjeff
      url-base: https://github.com/badjeff
    
    - name: Senkoi
      url-base: https://github.com/Senkoi

  projects:
    - name: zmk
      remote: zmkfirmware
      revision: main
      import: app/west.yml

    - name: zmk-pmw3610-driver
      remote: badjeff
      revision: main
    
    - name: zmk-feature-move-determin
      remote: Senkoi
      revision: main

  self:
    path: config
```
